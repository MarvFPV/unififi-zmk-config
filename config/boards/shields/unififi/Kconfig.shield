## config/boards/shields/unififi/Kconfig.shield
```kconfig
# Copyright (c) 2020 The ZMK Contributors
# SPDX-License-Identifier: MIT

config SHIELD_Unififi
   def_bool $(shields_list_contains,unififi)
```
